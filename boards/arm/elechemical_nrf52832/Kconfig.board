## boards/arm/elechemical_nrf52832/Kconfig.board
```kconfig
# Copyright (c) 2023 Nordic Semiconductor ASA
# SPDX-License-Identifier: Apache-2.0

config BOARD_ELECHEMICAL_NRF52832
	bool "elechemical-nrf52832"
	depends on SOC_NRF52832_CIAA
```

## boards/arm/elechemical_nrf52832/Kconfig.defconfig
```kconfig
# Copyright (c) 2023 Nordic Semiconductor ASA
# SPDX-License-Identifier: Apache-2.0

if BOARD_ELECHEMICAL_NRF52832

config BOARD
	default "elechemical_nrf52832"

config BT_CTLR
   default BT

endif
```
